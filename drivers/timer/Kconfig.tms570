## drivers/timer/Kconfig.tms570
```kconfig
config TMS570_TIMER
    bool 
    select TIMER_HAS_64BIT_CYCLE_COUNTER
    select TIMER_READS_ITS_FREQUENCY_AT_RUNTIME
    default y if DT_HAS_TI_TMS570_TIMER_ENABLED
```
